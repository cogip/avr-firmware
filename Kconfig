## Kconfig
```kconfig
#
# MCU firmware configuration
#
mainmenu "MCU firmware configuration"

menu "Platform configuration"

choice
	prompt "Target"
	default BIG_BOT2015

config BIG_BOT2015
	bool "Geonobot BR (2015)"
	select ANALOG_SENSORS
	select GP2Y0A21
	help
	  This will build the Big bot firmware.

config BIG_BOT2017
	bool "Cortex (2017)"
	#select ANALOG_SENSORS
	help
	  This will build the Big bot firmware.

config SMALL_BOT2017
	bool "Minus (2017)"
	#select ANALOG_SENSORS
	help
	  This will build the Small bot firmware.

endchoice

config PLATFORM_NAME
	string
	default "geonobot" if BIG_BOT2015
	default "cortex" if BIG_BOT2017
	default "minus" if SMALL_BOT2017

config CROSS_COMPILE
        string "Cross-compiler prefix"
        default "avr-"
        help
          Same as running 'make CROSS_COMPILE=prefix-' but stored for
          default make runs in this build directory.

config MCU
	string "MCU type"
	default "atxmega128a3u" if BIG_BOT2017 || SMALL_BOT2017
	default "atxmega128a1" if BIG_BOT2015
	help
	  This define the argument to "-mcu" option while calling the
	  cross-compiler.

config F_CPU
	int "F_CPU (Hz)"
	default 32000000
	help
	  This define the micro-controller CPU frequency (default: 32 MHz).

endmenu # "Platform configuration"

config ENABLE_LOGGING
	bool "Enable logs on UART"
	default n
	help
	  Select this if you want to enable the logs output on a dedicated UART.

config DEFAULT_LOGLEVEL
	int "Logs level"
	depends on ENABLE_LOGGING
	default 0
	help
	  Configure loglevel. Valid loglevels are 0 for error logs to 3
	  which activates all log for: errors(0), warning(1), info(2) and
	  debug(3).

config CALIBRATION
	bool "Calibration mode"
	default y
	help
	  Select this if you want to include calibration mode feature inside
	  firmware.

config KOS_CHECK_STACKS
	bool "Task stacks integrity checks"
	default y
	help
	  Select this if you want the OS to include markers on top and bottom
	  positions of task stacks. This add a some runtime overhead while
	  scheduler is called to switch tasks context. Anyway, this is important
	  to detect stack overflow & dimension tasks stack accordingly.
	  If unsure, say Y.

source drivers/Kconfig
```

## configs/cortex_defconfig
```kconfig
CONFIG_ARCH="xmega"
CONFIG_BIG_BOT2017=y
CONFIG_PLATFORM_NAME="cortex"
CONFIG_CROSS_COMPILE="avr-"
CONFIG_MCU="atxmega128a3u"
CONFIG_F_CPU=32000000
CONFIG_ENABLE_LOGGING=y
CONFIG_DEFAULT_LOGLEVEL=3
CONFIG_CALIBRATION=y
CONFIG_KOS_CHECK_STACKS=y
CONFIG_SD21=y
CONFIG_SD21_INIT_AT_STARTUP=y
CONFIG_ANALOG_SENSORS=y
```

## configs/cortex_simu_defconfig
```kconfig
CONFIG_ARCH="unix"
CONFIG_SIMU_NORMAL_SPEED=y
CONFIG_BIG_BOT2017=y
CONFIG_PLATFORM_NAME="cortex"
CONFIG_CROSS_COMPILE=""
CONFIG_MCU=""
CONFIG_F_CPU=32000000
CONFIG_ENABLE_LOGGING=y
CONFIG_DEFAULT_LOGLEVEL=3
CONFIG_CALIBRATION=y
CONFIG_KOS_CHECK_STACKS=y
CONFIG_SD21=y
CONFIG_ANALOG_SENSORS=y
```

## configs/geonobot_defconfig
```kconfig
CONFIG_ARCH="xmega"
CONFIG_BIG_BOT2015=y
CONFIG_PLATFORM_NAME="geonobot"
CONFIG_CROSS_COMPILE="avr-"
CONFIG_MCU="atxmega128a1"
CONFIG_F_CPU=32000000
CONFIG_ENABLE_LOGGING=y
CONFIG_DEFAULT_LOGLEVEL=3
CONFIG_CALIBRATION=y
CONFIG_KOS_CHECK_STACKS=y
CONFIG_SD21=y
CONFIG_ANALOG_SENSORS=y
```

## drivers/Kconfig
```kconfig
menu "Drivers"

source drivers/actuators/Kconfig
source drivers/sensors/Kconfig
source drivers/system/Kconfig

endmenu
```

## drivers/actuators/Kconfig
```kconfig
menu "Installed actuators"

config SD21
	bool "SD-21 Extension board"
	default n
	help
	   This add support of SD21 for servo control.

config SD21_INIT_AT_STARTUP
	bool "Send init value at startup"
	depends on SD21
	default y
	help
	   This send init value to SD-21 daughter board at power-on. Disable
	   this feature when servo are not calibrated to let the board to set
	   them to middle point by default.

endmenu
```

## drivers/sensors/Kconfig
```kconfig
menu "Installed sensors"

config ANALOG_SENSORS
	bool "Analog sensors"
	default n
	help
	   Platform should select this switch if analog sensors are used.

config GP2D120
	bool "GP2D120"
	depends on ANALOG_SENSORS
	default n
	help
	   GP2D120 IR Sharp support.

config GP2Y0A21
	bool "GP2Y0A21"
	depends on ANALOG_SENSORS
	default n
	help
	   GP2Y0A21 IR Sharp support.

config GP2Y0A41
	bool "GP2Y0A41"
	depends on ANALOG_SENSORS
	default n
	help
	   GP2Y0A41 IR Sharp support.

endmenu
```

## drivers/system/Kconfig
```kconfig
menu "System features"

config MCURSES
	bool "Mcurses"
	default n
	help
	   This add support of VT102 escape code and relevant API to display
	   bot variables in a split area of the console.

endmenu
```
